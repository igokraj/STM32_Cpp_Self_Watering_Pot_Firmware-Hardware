#include "ssd1306.hpp"

// I2C control bytes: 0x00 prefixes a command, 0x40 prefixes display data
#define SSD1306_CMD   0x00
#define SSD1306_DATA  0x40

// A full 1 KB frame at 100 kHz takes ~92 ms, so the data transfer needs a longer
// timeout than single commands. Both are kept short enough that a missing display
// cannot stall init() past the ~2 s watchdog window.
#define I2C_CMD_TIMEOUT   50
#define I2C_DATA_TIMEOUT  250

// 5x7 font, column-major (bit0 = top row). Index = ASCII - 32, covers ' '..'Z'.
static const uint8_t Font5x7[][5] = {
    {0x00, 0x00, 0x00, 0x00, 0x00}, // ' '
    {0x00, 0x00, 0x00, 0x00, 0x00}, // unused
    {0x00, 0x00, 0x00, 0x00, 0x00}, // unused
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    {0x61, 0x51, 0x49, 0x45, 0x43}, // 'Z'
};

// 32x32 flower-pot icon, row-major, 4 bytes per row (MSB = leftmost pixel)
const uint8_t IconPlant[128] = {
    0x00, 0x00, 0x00, 0x00,
    0x00, 0x00, 0x00, 0x00,
    0x00, 0x0E, 0x70, 0x00,
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    0x00, 0x7F, 0xFE, 0x00,
};

void Display::command(uint8_t cmd) {
    uint8_t packet[2] = {SSD1306_CMD, cmd};
    HAL_I2C_Master_Transmit(i2c_, address_, packet, sizeof(packet), I2C_CMD_TIMEOUT);
}

void Display::init() {
    HAL_Delay(100);  // let the panel's internal power-up settle

    command(0xAE);              // display off
    command(0x20); command(0x00);  // horizontal addressing mode
    command(0x40);              // start line = 0
    command(0xA1);              // segment remap (left-right flip)
    command(0xC8);              // COM scan direction (up-down flip)
    command(0xA8); command(0x3F);  // multiplex ratio = 64 rows
    command(0xD3); command(0x00);  // no display offset
    command(0xD5); command(0x80);  // clock divide / oscillator frequency
    command(0xD9); command(0x22);  // pre-charge period
    command(0xDA); command(0x12);  // COM pins: alternative, no remap
    command(0xDB); command(0x20);  // VCOMH deselect level
    command(0x81); command(0x9F);  // contrast
    command(0xA4);              // resume from RAM (not "all pixels on")
    command(0xA6);              // normal (not inverted)
    command(0x8D); command(0x14);  // enable internal charge pump
    command(0xAF);              // display on

    clear();
    flush();
}

void Display::clear() {
    for (uint16_t i = 0; i < sizeof(buffer_); i++) {
        buffer_[i] = 0;
    }
}

void Display::pixel(uint8_t x, uint8_t y, bool on) {
    if (x >= Width || y >= Height) {
        return;
    }
    uint16_t index = x + (y / 8) * Width;
    uint8_t mask = static_cast<uint8_t>(1 << (y % 8));
    if (on) {
        buffer_[index] |= mask;
    } else {
        buffer_[index] &= static_cast<uint8_t>(~mask);
    }
}

void Display::hline(uint8_t x, uint8_t y, uint8_t width) {
    for (uint8_t i = 0; i < width; i++) {
        pixel(static_cast<uint8_t>(x + i), y);
    }
}

void Display::text(uint8_t x, uint8_t y, const char *str) {
    for (; *str != '\0'; str++) {
        char c = *str;
        if (c >= 'a' && c <= 'z') {
            c = static_cast<char>(c - ('a' - 'A'));  // font only holds uppercase
        }
        uint8_t index = (c >= ' ' && c <= 'Z') ? static_cast<uint8_t>(c - ' ') : 0;

        for (uint8_t col = 0; col < 5; col++) {
            uint8_t bits = Font5x7[index][col];
            for (uint8_t row = 0; row < 7; row++) {
                if (bits & (1 << row)) {
                    pixel(static_cast<uint8_t>(x + col), static_cast<uint8_t>(y + row));
                }
            }
        }
        x = static_cast<uint8_t>(x + 6);  // 5 px glyph + 1 px gap
        if (x >= Width) {
            return;
        }
    }
}

void Display::bitmap(uint8_t x, uint8_t y, const uint8_t *bmp, uint8_t w, uint8_t h) {
    uint8_t bytesPerRow = static_cast<uint8_t>((w + 7) / 8);
    for (uint8_t row = 0; row < h; row++) {
        for (uint8_t col = 0; col < w; col++) {
            uint8_t byte = bmp[row * bytesPerRow + col / 8];
            if (byte & (0x80 >> (col % 8))) {
                pixel(static_cast<uint8_t>(x + col), static_cast<uint8_t>(y + row));
            }
        }
    }
}

void Display::flush() {
    command(0x21); command(0); command(Width - 1);       // column address range
    command(0x22); command(0); command(Height / 8 - 1);  // page address range

    HAL_I2C_Mem_Write(i2c_, address_, SSD1306_DATA, I2C_MEMADD_SIZE_8BIT,
                      buffer_, sizeof(buffer_), I2C_DATA_TIMEOUT);
}
